## boards/shields/dongle/Kconfig.shield
```kconfig
# No whitespace after the comma or in the keyboard name!
config SHIELD_DONGLE
    def_bool $(shields_list_contains,lizard-5x12-nicenano_dongle)
```

## boards/shields/lizard-5x12-ble/Kconfig.defconfig
```kconfig
if SHIELD_lizard-5x12-ble

# Name must be less than 16 characters long!
config ZMK_KEYBOARD_NAME
    default "ZMK lizard-5x12-ble"

endif
```

## boards/shields/lizard-5x12-ble/Kconfig.shield
```kconfig
# No whitespace after the comma or in your keyboard name!
config SHIELD_lizard-5x12-ble
    def_bool $(shields_list_contains,lizard-5x12-ble)
```

## boards/shields/lizard-5x12-nicenano/Kconfig.defconfig
```kconfig
if SHIELD_lizard-5x12-nicenano

# Name must be less than 16 characters long!
config ZMK_KEYBOARD_NAME
    default "lizard-5x12-nicenano"

endif
```

## boards/shields/lizard-5x12-nicenano/Kconfig.shield
```kconfig
# No whitespace after the comma or in your keyboard name!
config SHIELD_lizard-5x12-nicenano
    def_bool $(shields_list_contains,lizard-5x12-nicenano)
```

## boards/shields/lizard/Kconfig.defconfig
```kconfig
if SHIELD_lizard

# Name must be less than 16 characters long!
config ZMK_KEYBOARD_NAME
    default "lizard"

endif
```

## boards/shields/lizard/Kconfig.shield
```kconfig
# No whitespace after the comma or in your keyboard name!
config SHIELD_LIZARD
    def_bool $(shields_list_contains,lizard)

config SHIELD_LIZARD_DONGLE
    def_bool $(shields_list_contains,lizard_dongle)
```
